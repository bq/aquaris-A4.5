## drivers/input/touchscreen/mediatek/AH1887/Kconfig
```kconfig
#
# Touchscreen driver configuration
#

if TOUCHSCREEN_MTK_AH1887

config AH1887_CONFIG
	string "AH1887 for Mediatek config"

endif
```

## drivers/input/touchscreen/mediatek/ATMEL_MXT336/Kconfig
```kconfig
#
# Touchscreen driver configuration
#
if TOUCHSCREEN_MTK_ATMEL_MXT336

config ATMEL_MXT336_CONFIG
	string "ATMEL_MXT336 for Mediatek config"

endif
```
